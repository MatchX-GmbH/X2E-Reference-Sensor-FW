## GPS_Tracker/main/Kconfig.projbuild
```kconfig
menu "MatchX"
    choice MATCHX_TARGET_BOARD
        prompt "Target board"
        default MATCHX_TARGET_NEXUS
        help
            Select the target board.
            It will affect the build of components, such as LoRa.

        config MATCHX_TARGET_X2E_REF
            bool "X2E Reference Sensor"

        config MATCHX_TARGET_NEXUS
            bool "NEXUS"

    endchoice #MATCHX_TARGET_BOARD
endmenu
```

## demo_controls/main/Kconfig.projbuild
```kconfig
menu "MatchX"
    choice MATCHX_TARGET_BOARD
        prompt "Target board"
        default MATCHX_TARGET_X2E_REF
        help
            Select the target board.
            It will affect the build of components, such as LoRa.

        config MATCHX_TARGET_X2E_REF
            bool "X2E Reference Sensor"

    endchoice #MATCHX_TARGET_BOARD

    config MATCHX_DISABlE_SLEEP
        bool "Disable sleep handling"
        default y
        help
            Never enter sleep.

    config MATCHX_DEBUG
        bool "Show debug message"
        default n
        help
            Showing application debug message.

    config MATCHX_BATTERY_DESING_CAPACITY
        int "Design Capacity for the battery"
        default 1200
        range 0 30000
        help
            Set the design capacity for the battery in mAh.

endmenu
```

## example_device/main/Kconfig.projbuild
```kconfig
menu "MatchX"
    choice MATCHX_TARGET_BOARD
        prompt "Target board"
        default MATCHX_TARGET_NEXUS
        help
            Select the target board.
            It will affect the build of components, such as LoRa.

        config MATCHX_TARGET_X2E_REF
            bool "X2E Reference Sensor"

        config MATCHX_TARGET_NEXUS
            bool "NEXUS"

    endchoice #MATCHX_TARGET_BOARD

    config MATCHX_SLEEP_PULL_I2C_LOW
        bool "Pull low I2C when sleep"
        default n
        help
            By pulling the I2C low, the onboard BQ27220 I2C engine will enter sleep
            and consuming less.
            When enable this, please remove all I2C pull-up resisters.

    config MATCHX_DEBUG
        bool "Show debug message"
        default n
        help
            Showing application debug message.

    config MATCHX_BATTERY_DESING_CAPACITY
        int "Design Capacity for the battery"
        default 1200
        range 0 30000
        help
            Set the design capacity for the battery in mAh.

endmenu
```

## testing/test_ntag/components/NxpNfcRdLib/Kconfig
```kconfig
menu "NFC"
    config NFCCOMPON_DEBUG
        bool "Show component debug message"
        default n

endmenu
```

## testing/test_spi/main/Kconfig.projbuild
```kconfig
menu "MatchX"
    choice MATCHX_TARGET_BOARD
        prompt "Target board"
        default MATCHX_TARGET_X2E_REF
        help
            Select the target board.
            It will affect the build of components, such as LoRa.

        config MATCHX_TARGET_X2E_REF
            bool "X2E Reference Sensor"

    endchoice #MATCHX_TARGET_BOARD

    config MATCHX_SLEEP_PULL_I2C_LOW
        bool "Pull low I2C when sleep"
        default n
        help
            By pulling the I2C low, the onboard BQ27220 I2C engine will enter sleep
            and consuming less.
            When enable this, please remove all I2C pull-up resisters.

    config MATCHX_ENABLE_DEEP_SLEEP
        bool "Enable deep sleep"
        default n
        help
            Put the device into deep sleep.

    config MATCHX_DEBUG
        bool "Show debug message"
        default n
        help
            Showing application debug message.

    config MATCHX_BATTERY_DESING_CAPACITY
        int "Design Capacity for the battery"
        default 1200
        range 0 30000
        help
            Set the design capacity for the battery in mAh.

endmenu
```
